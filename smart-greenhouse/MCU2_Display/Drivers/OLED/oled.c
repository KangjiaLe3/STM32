#include "oled.h"
#include "../../Core/Inc/i2c.h"
#include "../../Core/Inc/main.h"

static const uint8_t F6x8[][6] = {
    {0x00,0x00,0x00,0x00,0x00,0x00}, // sp
    {0x00,0x00,0x00,0x2f,0x00,0x00}, // !
    {0x00,0x00,0x07,0x00,0x07,0x00}, // "
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    {0x00,0x32,0x49,0x59,0x51,0x3E}, // @
};

static void OLED_WriteCmd(uint8_t cmd) {
    I2C_Start();
    I2C_SendByte(OLED_ADDR);
    I2C_SendByte(0x00);
    I2C_SendByte(cmd);
    I2C_Stop();
}

static void OLED_WriteData(uint8_t data) {
    I2C_Start();
    I2C_SendByte(OLED_ADDR);
    I2C_SendByte(0x40);
    I2C_SendByte(data);
    I2C_Stop();
}

void OLED_Init(void) {
    delay_ms(100);
    OLED_WriteCmd(0xAE);
    OLED_WriteCmd(0x20); OLED_WriteCmd(0x10);
    OLED_WriteCmd(0xB0);
    OLED_WriteCmd(0xC8);
    OLED_WriteCmd(0x00); OLED_WriteCmd(0x10);
    OLED_WriteCmd(0x40);
    OLED_WriteCmd(0x81); OLED_WriteCmd(0xFF);
    OLED_WriteCmd(0xA1);
    OLED_WriteCmd(0xA6);
    OLED_WriteCmd(0xA8); OLED_WriteCmd(0x3F);
    OLED_WriteCmd(0xA4);
    OLED_WriteCmd(0xD3); OLED_WriteCmd(0x00);
    OLED_WriteCmd(0xD5); OLED_WriteCmd(0xF0);
    OLED_WriteCmd(0xD9); OLED_WriteCmd(0x22);
    OLED_WriteCmd(0xDA); OLED_WriteCmd(0x12);
    OLED_WriteCmd(0xDB); OLED_WriteCmd(0x20);
    OLED_WriteCmd(0x8D); OLED_WriteCmd(0x14);
    OLED_WriteCmd(0xAF);
    OLED_Clear();
}

void OLED_Clear(void) {
    for(uint8_t i = 0; i < 8; i++) {
        OLED_WriteCmd(0xB0 + i);
        OLED_WriteCmd(0x00);
        OLED_WriteCmd(0x10);
        for(uint8_t j = 0; j < 128; j++) {
            OLED_WriteData(0x00);
        }
    }
}

void OLED_SetPos(uint8_t x, uint8_t y) {
    OLED_WriteCmd(0xB0 + y);
    OLED_WriteCmd(((x & 0xF0) >> 4) | 0x10);
    OLED_WriteCmd(x & 0x0F);
}

void OLED_ShowChar(uint8_t x, uint8_t y, char chr) {
    uint8_t c = chr - ' ';
    if(x > 126 || y > 7) return;
    OLED_SetPos(x, y);
    for(uint8_t i = 0; i < 6; i++) {
        OLED_WriteData(F6x8[c][i]);
    }
}

void OLED_ShowString(uint8_t x, uint8_t y, char *str) {
    while(*str) {
        OLED_ShowChar(x, y, *str);
        x += 6;
        if(x > 122) {
            x = 0;
            y++;
        }
        str++;
    }
}

void OLED_ShowNum(uint8_t x, uint8_t y, uint32_t num, uint8_t len) {
    uint8_t t, temp;
    for(t = 0; t < len; t++) {
        temp = (num / (uint32_t)(1 << (len - t - 1) * 4)) % 10;
        OLED_ShowChar(x + t * 6, y, temp + '0');
    }
}
