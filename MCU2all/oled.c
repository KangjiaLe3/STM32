/**
  ******************************************************************************
  * @file    oled.c
  * @author  Smart Greenhouse Project - MCU2
  * @version V1.0
  * @date    2024
  * @brief   OLED显示屏驱动
  ******************************************************************************
  */

/* Includes ------------------------------------------------------------------*/
#include "oled.h"
#include "bsp_i2c.h"

/* 外部延时函数 */
extern void Delay_ms(uint32_t nTime);

/* 6x8字体 */
static const uint8_t F6x8[][6] = {
    {0x00,0x00,0x00,0x00,0x00,0x00}, // sp
    {0x00,0x00,0x00,0x2f,0x00,0x00}, // !
    {0x00,0x00,0x07,0x00,0x07,0x00}, // "
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    {0x00,0x61,0x51,0x49,0x45,0x43}, // Z
};

/**
  * @brief  OLED写命令
  * @param  cmd: 命令
  * @retval None
  */
static void OLED_WriteCmd(uint8_t cmd)
{
    BSP_I2C_Start();
    BSP_I2C_SendByte(OLED_ADDR);
    BSP_I2C_WaitAck();
    BSP_I2C_SendByte(0x00);
    BSP_I2C_WaitAck();
    BSP_I2C_SendByte(cmd);
    BSP_I2C_WaitAck();
    BSP_I2C_Stop();
}

/**
  * @brief  OLED写数据
  * @param  data: 数据
  * @retval None
  */
static void OLED_WriteData(uint8_t data)
{
    BSP_I2C_Start();
    BSP_I2C_SendByte(OLED_ADDR);
    BSP_I2C_WaitAck();
    BSP_I2C_SendByte(0x40);
    BSP_I2C_WaitAck();
    BSP_I2C_SendByte(data);
    BSP_I2C_WaitAck();
    BSP_I2C_Stop();
}

/**
  * @brief  OLED初始化
  * @param  None
  * @retval None
  */
void OLED_Init(void)
{
    Delay_ms(100);

    OLED_WriteCmd(0xAE); // 关闭显示
    OLED_WriteCmd(0x20); OLED_WriteCmd(0x10); // 设置内存地址模式
    OLED_WriteCmd(0xB0); // 设置页地址
    OLED_WriteCmd(0xC8); // 设置COM扫描方向
    OLED_WriteCmd(0x00); OLED_WriteCmd(0x10); // 设置列地址
    OLED_WriteCmd(0x40); // 设置起始行
    OLED_WriteCmd(0x81); OLED_WriteCmd(0xFF); // 设置对比度
    OLED_WriteCmd(0xA1); // 设置段重映射
    OLED_WriteCmd(0xA6); // 正常显示
    OLED_WriteCmd(0xA8); OLED_WriteCmd(0x3F); // 设置复用率
    OLED_WriteCmd(0xA4); // 全局显示开启
    OLED_WriteCmd(0xD3); OLED_WriteCmd(0x00); // 设置显示偏移
    OLED_WriteCmd(0xD5); OLED_WriteCmd(0xF0); // 设置时钟分频
    OLED_WriteCmd(0xD9); OLED_WriteCmd(0x22); // 设置预充电周期
    OLED_WriteCmd(0xDA); OLED_WriteCmd(0x12); // 设置COM引脚配置
    OLED_WriteCmd(0xDB); OLED_WriteCmd(0x20); // 设置VCOMH
    OLED_WriteCmd(0x8D); OLED_WriteCmd(0x14); // 使能电荷泵
    OLED_WriteCmd(0xAF); // 开启显示

    OLED_Clear();
}

/**
  * @brief  OLED清屏
  * @param  None
  * @retval None
  */
void OLED_Clear(void)
{
    uint8_t i, j;
    for(i = 0; i < 8; i++)
    {
        OLED_WriteCmd(0xB0 + i);
        OLED_WriteCmd(0x00);
        OLED_WriteCmd(0x10);
        for(j = 0; j < 128; j++)
        {
            OLED_WriteData(0x00);
        }
    }
}

/**
  * @brief  OLED设置光标位置
  * @param  x: 列地址
  * @param  y: 页地址
  * @retval None
  */
void OLED_SetPos(uint8_t x, uint8_t y)
{
    OLED_WriteCmd(0xB0 + y);
    OLED_WriteCmd(((x & 0xF0) >> 4) | 0x10);
    OLED_WriteCmd(x & 0x0F);
}

/**
  * @brief  OLED显示字符
  * @param  x: 列地址
  * @param  y: 页地址
  * @param  chr: 字符
  * @retval None
  */
void OLED_ShowChar(uint8_t x, uint8_t y, char chr)
{
    uint8_t c = chr - ' ';
    uint8_t i;

    if(x > 126 || y > 7) return;

    OLED_SetPos(x, y);
    for(i = 0; i < 6; i++)
    {
        OLED_WriteData(F6x8[c][i]);
    }
}

/**
  * @brief  OLED显示字符串
  * @param  x: 列地址
  * @param  y: 页地址
  * @param  str: 字符串
  * @retval None
  */
void OLED_ShowString(uint8_t x, uint8_t y, char *str)
{
    while(*str)
    {
        OLED_ShowChar(x, y, *str);
        x += 6;
        if(x > 122)
        {
            x = 0;
            y++;
        }
        str++;
    }
}

/**
  * @brief  OLED显示数字
  * @param  x: 列地址
  * @param  y: 页地址
  * @param  num: 数字
  * @param  len: 长度
  * @retval None
  */
void OLED_ShowNum(uint8_t x, uint8_t y, uint32_t num, uint8_t len)
{
    uint8_t t, temp;
    uint8_t enshow = 0;

    for(t = 0; t < len; t++)
    {
        temp = (num / (uint32_t)(1 << (len - t - 1) * 4)) % 10;
        if(enshow == 0 && t < (len - 1))
        {
            if(temp == 0)
            {
                OLED_ShowChar(x + t * 6, y, ' ');
                continue;
            }
            else
            {
                enshow = 1;
            }
        }
        OLED_ShowChar(x + t * 6, y, temp + '0');
    }
}
